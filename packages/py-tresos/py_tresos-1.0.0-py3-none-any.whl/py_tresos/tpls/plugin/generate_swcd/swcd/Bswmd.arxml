AUTOSAR XML (schema 00048)
package /#{AR_PACKAGE}/#{COMPONENT}_BswImplementations
  bsw implementation Impl_Bsw_#{COMPONENT}: sw-version=1.0.0, vendor-id=#{VENDOR_ID}, ar-release-version=4.4.0, behavior=Bsw_#{COMPONENT}_IB
    code-descriptors:
      code SRC: artifact-descriptors=autosar-engineering-object={short-label=EngObject, category=SWSRC}
    resource consumption Resources
      memory section CODE: sw-addrmethod=CODE
package /#{AR_PACKAGE}/#{COMPONENT}_Bswmd
  bsw module description #{COMPONENT}: category=BSW_MODULE, module-id=255, provided-entrys=#{COMPONENT}_MainFunction
    bsw internal behavior Bsw_#{COMPONENT}_IB
      bsw schedulable entity BswSchedEntity_MainFuntion: reentrancy-level=NON-REENTRANT, implemented-entry=#{COMPONENT}_MainFunction
      bsw timing event TimingEvent_MainFuntion: starts-on-event=BswSchedEntity_MainFuntion, period=0.05
  bsw module entry #{COMPONENT}_MainFunction: service-id=0, is-reentrant=false, is-synchronous=true, call-type=SCHEDULED, execution-context=TASK, sw-service-impl-policy=STANDARD
