AUTOSAR XML (schema 00048)
package /#{AR_PACKAGE}/#{COMPONENT}_PortInterfaces
  client server interface IFCS_#{COMPONENT}
    operation #{COMPONENT}_global_service: possible-error=E_NOT_OK
    error E_NOT_OK: error-code=1
